/*
* SpectrumToGenericRC.c
*
* Copyright (C) 2022  Martin Lundh
*
* Permission is hereby granted, free of charge, to any person obtaining a copy
* of this software and associated documentation files (the "Software"), to deal
* in the Software without restriction, including without limitation the rights
* to use, copy, modify, merge, publish, distribute, sublicense, and/or sell
* copies of the Software, and to permit persons to whom the Software is
* furnished to do so, subject to the following conditions:
*
* The above copyright notice and this permission notice shall be included in
* all copies or substantial portions of the Software.
*
* THE SOFTWARE IS PROVIDED "AS IS", WITHOUT WARRANTY OF ANY KIND, EXPRESS OR
* IMPLIED, INCLUDING BUT NOT LIMITED TO THE WARRANTIES OF MERCHANTABILITY,
* FITNESS FOR A PARTICULAR PURPOSE AND NONINFRINGEMENT. IN NO EVENT SHALL THE
* AUTHORS OR COPYRIGHT HOLDERS BE LIABLE FOR ANY CLAIM, DAMAGES OR OTHER
* LIABILITY, WHETHER IN AN ACTION OF CONTRACT, TORT OR OTHERWISE, ARISING FROM,
* OUT OF OR IN CONNECTION WITH THE SOFTWARE OR THE USE OR OTHER DEALINGS IN
* THE SOFTWARE.
*/

#include "Components/SpectrumToGenericRC/inc/SpectrumToGenericRC.h"
#include "Components/AppLog/inc/AppLog.h"
#include "Parameters/inc/paramHandler.h"
#include "EventHandler/inc/event_handler.h"
#include "Messages/inc/Msg_SpectrumData.h"
#include "Utilities/inc/my_math.h"
#include "Messages/inc/Msg_NewRcSetpoint.h"


#define MESSAGE_VALID_FOR_MS (50) // A setpoint generated by this module is valid for 50ms.
#define SATELLITE_CH_CENTER (1022)


/**
 * max receiver value: 100% = 7FF/2 = 3FF = 1023 
 * max control signal:    100% = 1<<16 = 65536
 * 
 * 
 * (max control signal)/(max receiver value) = 64
 * 
 * This is the quote used to scale between receiver
 * and generic 16.16 scaling where 1 = 100% signal.
 * This leads to the following define:
 */
#define SATELLITE_TO_16_16_FP (64)

uint8_t SatGenericHandler_HandleSatFrame(eventHandler_t* obj, void* data, moduleMsg_t* msg);

spectrumGenericHandler_t* SatGenericHandler_CreateObj(eventHandler_t* evHandler)
{
    spectrumGenericHandler_t *obj = pvPortMalloc( sizeof(spectrumGenericHandler_t) );

    if(!obj || !evHandler)
    {
        return NULL;
    }
    obj->evHandler = evHandler;
    obj->currentSignal = pvPortMalloc(sizeof(genericRC_t));

    Event_RegisterCallback(obj->evHandler, Msg_SpectrumData_e, SatGenericHandler_HandleSatFrame, obj);

    return obj;
}

void SatSpHandler_DeleteObj(spectrumGenericHandler_t* obj)
{
  if(obj)
  {
    vPortFree(obj);
  }
}

void SatSpHandler_MapToSetpoint(spectrumGenericHandler_t* obj, spektrum_data_t *reciever_data, genericRC_t *setpoint)
{
    //subtract center point and convert to generic scale. 16 bit signed centered.

    setpoint->channel[channel0]  = my_mult((reciever_data->ch[0].value  - SATELLITE_CH_CENTER), SATELLITE_TO_16_16_FP, 0);
    setpoint->channel[channel1]  = my_mult((reciever_data->ch[1].value  - SATELLITE_CH_CENTER), SATELLITE_TO_16_16_FP, 0);
    setpoint->channel[channel2]  = my_mult((reciever_data->ch[2].value  - SATELLITE_CH_CENTER), SATELLITE_TO_16_16_FP, 0);
    setpoint->channel[channel3]  = my_mult((reciever_data->ch[3].value  - SATELLITE_CH_CENTER), SATELLITE_TO_16_16_FP, 0);
    setpoint->channel[channel4]  = my_mult((reciever_data->ch[4].value  - SATELLITE_CH_CENTER), SATELLITE_TO_16_16_FP, 0);
    setpoint->channel[channel5]  = my_mult((reciever_data->ch[5].value  - SATELLITE_CH_CENTER), SATELLITE_TO_16_16_FP, 0);
    setpoint->channel[channel6]  = my_mult((reciever_data->ch[6].value  - SATELLITE_CH_CENTER), SATELLITE_TO_16_16_FP, 0);
    setpoint->channel[channel7]  = my_mult((reciever_data->ch[7].value  - SATELLITE_CH_CENTER), SATELLITE_TO_16_16_FP, 0);
    setpoint->channel[channel8]  = my_mult((reciever_data->ch[8].value  - SATELLITE_CH_CENTER), SATELLITE_TO_16_16_FP, 0);
    setpoint->channel[channel9]  = my_mult((reciever_data->ch[9].value  - SATELLITE_CH_CENTER), SATELLITE_TO_16_16_FP, 0);
    setpoint->channel[channel10] = my_mult((reciever_data->ch[10].value - SATELLITE_CH_CENTER), SATELLITE_TO_16_16_FP, 0);
    setpoint->channel[channel11] = my_mult((reciever_data->ch[11].value - SATELLITE_CH_CENTER), SATELLITE_TO_16_16_FP, 0);
    return;
}

uint8_t SatGenericHandler_HandleSatFrame(eventHandler_t* obj, void* data, moduleMsg_t* msg)
{
    if(!obj || !data || !msg)
    {
        return 0;
    }
    spectrumGenericHandler_t* handlerObj = (spectrumGenericHandler_t*)data; // data should always be the current handler.

    TickType_t ticks = xTaskGetTickCount();
    TickType_t ticksSinceLast = ticks - handlerObj->timeAtLastSignal;
    // We get new setpoints every 11 or 22 ms from a spectrum satellite, if two messages arrive
    // too closely, it is because of multiple receivers. Disregard one of them.
    if(ticksSinceLast <= 1)
    {
        LOG_DBG_ENTRY( handlerObj->evHandler, "Dropping a SP.");
        return 1;
    }
    LOG_DBG_ENTRY( handlerObj->evHandler, "New SP.");

    handlerObj->timeAtLastSignal = ticks;
    spektrum_data_t spectrumData = Msg_SpectrumDataGetData(msg);
    SatSpHandler_MapToSetpoint(handlerObj, &spectrumData, handlerObj->currentSignal);
    moduleMsg_t* msgSp = Msg_NewRcSetpointCreate(FC_Broadcast_e, 0, *handlerObj->currentSignal, 1, MESSAGE_VALID_FOR_MS);
    Event_Send(handlerObj->evHandler, msgSp);

    return 1;
}
